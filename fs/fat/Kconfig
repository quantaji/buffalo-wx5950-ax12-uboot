## fs/fat/Kconfig
```kconfig
config FS_FAT
	bool "FAT filesystem support"
	help
	  Enable read-only access to FAT filesystems. Writing remains disabled
	  unless FAT_WRITE is selected separately.
```

## net/Kconfig
```kconfig
#
# Network configuration
#

menuconfig NET
	bool "Networking support"

if NET

config NET_RANDOM_ETHADDR
	bool "Random ethaddr if unset"
	select LIB_RAND
	help
	  Selecting this will allow the Ethernet interface to function
	  even when the ethaddr variable for that interface is unset.
	  A new MAC address will be generated on every boot and it will
	  not be added to the environment.

config NETCONSOLE
	bool "NetConsole support"
	help
	  Support the 'nc' input/output device for networked console.
	  See README.NetConsole for details.

config NET_TFTP_VARS
	bool "Control TFTP timeout and count through environment"
	default y
	help
	  If set, allows controlling the TFTP timeout through the
	  environment variable tftptimeout, and the TFTP maximum
	  timeout count through the variable tftptimeoutcountmax.
	  If unset, timeout and maximum are hard-defined as 1 second
	  and 10 timouts per TFTP transfer.

config PROT_TCP
	bool "TCP stack"
	help
	  Enable the generic TCP stream framework.

config PROT_TCP_SACK
	bool "TCP selective acknowledgements"
	depends on PROT_TCP
	help
	  Track received TCP segments so missing segments can be retransmitted
	  without repeating data that has already arrived.

config WXR5950AX12_WEB
	bool "Buffalo WXR-5950AX12 fixed-IP and DHCP recovery web service"
	depends on BUFFALO_WXR5950AX12 && CMD_NET
	select PROT_TCP
	select PROT_TCP_SACK
	help
	  Serve the same WXR recovery and installation console using either
	  the fixed 192.168.11.1 address or an address obtained by DHCP.

endif   # if NET
```

## scripts/wxr5950ax12-ram.its
```
/dts-v1/;

/ {
	description = "Buffalo WXR-5950AX12 RAM U-Boot";
	#address-cells = <1>;

	images {
		kernel@1 {
			description = "WXR-5950AX12 RAM U-Boot";
			data = /incbin/("u-boot.bin.gz");
			type = "kernel";
			arch = "arm";
			os = "linux";
			compression = "gzip";
			load = <0x4a000000>;
			entry = <0x4a000000>;

			hash@1 {
				algo = "crc32";
			};

			hash@2 {
				algo = "sha1";
			};
		};

		fdt@hk01 {
			description = "Buffalo WXR-5950AX12 control DTB";
			data = /incbin/("ipq807x-wxr5950ax12.dtb");
			type = "flat_dt";
			arch = "arm";
			compression = "none";

			hash@1 {
				algo = "crc32";
			};

			hash@2 {
				algo = "sha1";
			};
		};
	};

	configurations {
		default = "config@hk01";

		config@hk01 {
			description = "WXR-5950AX12 RAM U-Boot";
			kernel = "kernel@1";
			fdt = "fdt@hk01";
		};
	};
};
```
